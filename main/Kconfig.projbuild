## main/Kconfig.projbuild
```kconfig
menu "Can_wizard Configuration"

    orsource "Kconfig.env_caps"

    config CAN_RX_GPIO
        int "CAN RX GPIO number"
        range ENV_GPIO_RANGE_MIN ENV_GPIO_OUT_RANGE_MAX
        default 9
        help
            GPIO number (IOxx) to connect ESP to CAN transceiver.
            Some GPIOs are used for other purposes (USB, flash connections, etc.) and cannot be used for CAN.

    config CAN_TX_GPIO
        int "CAN TX GPIO number"
        range ENV_GPIO_RANGE_MIN ENV_GPIO_OUT_RANGE_MAX
        default 8
        help
            GPIO number (IOxx) to connect ESP to CAN transceiver.
            Some GPIOs are used for other purposes (USB, flash connections, etc.) and cannot be used for CAN.

    config CAN_TASK_PRIORITY
        int "CAN task priority"
        range 0 22
        default 5
        help
            A priority of FreeRTOS task can_task. See more about tasks priorities in FreeRTOS documentation.

    config CONSOLE_TX_PRIORITY
        int "Console task TX priority"
        range 0 22
        default 2
        help
            A priority of FreeRTOS task can_task_tx. See more about tasks priorities in FreeRTOS documentation.

    config CONSOLE_INT_PRIORITY
        int "Console task interactive priority"
        range 0 22
        default 1
        help
            A priority of FreeRTOS task can_task_interactive. See more about tasks priorities in FreeRTOS documentation.

    config CONSOLE_MAX_CMDLINE_LENGTH
        int "Console max cmdline length"
        range 100 512
        default 256

    config CONSOLE_MAX_CMDLINE_ARGS 
        int "Console max cmdline args"
        range 1 32
        default 8

    config CAN_MAX_SMARTFILTERS_NUM
        int "Max number of smartfilters"
        range 2 20
        default 10

endmenu
```

## sdkconfig.defaults
```kconfig
# Part table + fs + flash
CONFIG_PARTITION_TABLE_CUSTOM=y
CONFIG_PARTITION_TABLE_CUSTOM_FILENAME="partitions.csv"
CONFIG_PARTITION_TABLE_FILENAME="partitions.csv"
CONFIG_ESPTOOLPY_FLASHSIZE_1MB=y
CONFIG_ESPTOOLPY_HEADER_FLASHSIZE_UPDATE=y


# UART
CONFIG_ESP_CONSOLE_USB_SERIAL_JTAG=y
CONFIG_ESP_CONSOLE_SECONDARY_NONE=y
CONFIG_ESP_CONSOLE_USB_SERIAL_JTAG_ENABLED=y
CONFIG_UART_ISR_IN_IRAM=y

# FreeRTOS
CONFIG_FREERTOS_HZ=1000
CONFIG_ESP_SYSTEM_EVENT_QUEUE_SIZE=32
CONFIG_ESP_SYSTEM_EVENT_TASK_STACK_SIZE=2304
CONFIG_ESP_MAIN_TASK_STACK_SIZE=7168
CONFIG_ESP_MINIMAL_SHARED_STACK_SIZE=2048

# Enable FreeRTOS stats formatting functions, needed for 'tasks' command
CONFIG_FREERTOS_USE_TRACE_FACILITY=y
CONFIG_FREERTOS_USE_STATS_FORMATTING_FUNCTIONS=y

# WDT
CONFIG_ESP_INT_WDT=y
CONFIG_ESP_INT_WDT_TIMEOUT_MS=2000
CONFIG_ESP_TASK_WDT_EN=y
CONFIG_ESP_TASK_WDT_INIT=y
CONFIG_ESP_TASK_WDT_TIMEOUT_S=15

# LittleFS
CONFIG_LITTLEFS_FLUSH_FILE_EVERY_WRITE=y
CONFIG_LITTLEFS_USE_MTIME=n

# Compiling and logs
CONFIG_BOOTLOADER_COMPILER_OPTIMIZATION_SIZE=y
CONFIG_BOOTLOADER_LOG_LEVEL_ERROR=y
CONFIG_BOOTLOADER_LOG_LEVEL=1
CONFIG_COMPILER_OPTIMIZATION_PERF=y
CONFIG_COMPILER_OPTIMIZATION_ASSERTIONS_SILENT=y
CONFIG_COMPILER_OPTIMIZATION_CHECKS_SILENT=y

# TWAI
CONFIG_TWAI_ISR_IN_IRAM=y
```
