## main/Kconfig.env_caps
```kconfig
# GPIO ranges per target, mirroring the ESP-IDF examples' Kconfig.env_caps.

config ENV_GPIO_RANGE_MIN
    int
    default 0

config ENV_GPIO_RANGE_MAX
    int
    default 39 if IDF_TARGET_ESP32
    default 46 if IDF_TARGET_ESP32S2
    default 48 if IDF_TARGET_ESP32S3
    default 20 if IDF_TARGET_ESP32C2
    default 21 if IDF_TARGET_ESP32C3
    default 30 if IDF_TARGET_ESP32C6
    default 27 if IDF_TARGET_ESP32H2
    default 54 if IDF_TARGET_ESP32P4
    default 21

config ENV_GPIO_IN_RANGE_MAX
    int
    default ENV_GPIO_RANGE_MAX

config ENV_GPIO_OUT_RANGE_MAX
    int
    default 33 if IDF_TARGET_ESP32
    default 45 if IDF_TARGET_ESP32S2
    default ENV_GPIO_RANGE_MAX
```
